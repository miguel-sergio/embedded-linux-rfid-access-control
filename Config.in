## Config.in
```kconfig
source "$BR2_EXTERNAL_RFID_ACCESS_PATH/package/drivers/rc522/Config.in"
source "$BR2_EXTERNAL_RFID_ACCESS_PATH/package/apps/rfid-access/Config.in"
```

## package/apps/rfid-access/Config.in
```kconfig
config BR2_PACKAGE_RFID_ACCESS
	bool "rfid-access"
	help
	  User space access control application for RFID cards.
```

## package/drivers/rc522/Config.in
```kconfig
config BR2_PACKAGE_RC522
	bool "rc522"
	depends on BR2_LINUX_KERNEL
	help
	  Linux SPI driver for the MFRC522 RFID reader.
```
